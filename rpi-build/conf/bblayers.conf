## rpi-build/conf/bblayers.conf
```bitbake
# POKY_BBLAYERS_CONF_VERSION is increased each time build/conf/bblayers.conf
# changes incompatibly
POKY_BBLAYERS_CONF_VERSION = "2"

BBPATH = "${TOPDIR}"
BBFILES ?= ""

BBLAYERS ?= " \
  /home/namsupahero123/poky/meta \
  /home/namsupahero123/poky/meta-poky \
  /home/namsupahero123/poky/meta-raspberrypi \
  "
```
